## Kconfig
```kconfig
menu "ESP Crash"
    config ESP_CRASH_DEFAULT_URL
        string "Default URL for coredump upload"
        default "https://esp-crash.wennlund.nu/dump"

    config ESP_CRASH_DEFAULT_FILENAME
        string "Default filename for coredump upload"
        default "core.dmp"

    config ESP_CRASH_TIMER_PERIOD_S
        int "Set upload timer period in seconds"
        default 60
        range 1 600
endmenu
```

## components/esp_crash/Kconfig
```kconfig
menu "ESP Crash"
    config ESP_CRASH_DEFAULT_URL
        string "Default URL for coredump upload"
        default "https://esp-crash.wennlund.nu/dump"

    config ESP_CRASH_DEFAULT_FILENAME
        string "Default filename for coredump upload"
        default "core.dmp"
endmenu
```

## examples/esp-crash-example/sdkconfig.defaults
```kconfig
# Reduce bootloader log verbosity
CONFIG_BOOTLOADER_LOG_LEVEL_WARN=y
CONFIG_BOOTLOADER_LOG_LEVEL=2

# Increase main task stack size
CONFIG_ESP_MAIN_TASK_STACK_SIZE=7168

#
# Core dump
#
CONFIG_ESP_COREDUMP_ENABLE_TO_FLASH=y
# CONFIG_ESP_COREDUMP_ENABLE_TO_UART is not set
# CONFIG_ESP_COREDUMP_ENABLE_TO_NONE is not set
# CONFIG_ESP_COREDUMP_DATA_FORMAT_BIN is not set
CONFIG_ESP_COREDUMP_DATA_FORMAT_ELF=y
CONFIG_ESP_COREDUMP_CHECKSUM_CRC32=y
CONFIG_ESP_COREDUMP_CHECK_BOOT=y
CONFIG_ESP_COREDUMP_ENABLE=y
CONFIG_ESP_COREDUMP_LOGS=y
CONFIG_ESP_COREDUMP_MAX_TASKS_NUM=64
CONFIG_ESP_COREDUMP_STACK_SIZE=0

# Enable filesystem
CONFIG_PARTITION_TABLE_CUSTOM=y
CONFIG_PARTITION_TABLE_CUSTOM_FILENAME="partitions.csv"
CONFIG_PARTITION_TABLE_FILENAME="partitions.csv"

# Enable FreeRTOS stats formatting functions, needed for 'tasks' command
CONFIG_FREERTOS_USE_TRACE_FACILITY=y
CONFIG_FREERTOS_USE_STATS_FORMATTING_FUNCTIONS=y

CONFIG_ESPTOOLPY_FLASHSIZE_4MB=y
```
